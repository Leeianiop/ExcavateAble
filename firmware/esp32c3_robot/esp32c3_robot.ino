/*
 * Excavatable - ESP32-C3 Super Mini servo driver
 * =============================================
 *
 * Talks to the SnakeBot backend (backend/app/robot/controller.py) over the
 * Nordic UART Service, so the website's Robot Control page can drive the
 * servos. Advertises as ESP32C3_Servo.
 *
 * Arduino IDE settings:
 *   Board:            "ESP32C3 Dev Module"
 *   USB CDC On Boot:  Enabled
 *   Libraries:        Adafruit PWM Servo Driver Library
 *
 * Wiring:
 *   GPIO5   I2C SDA -> PCA9685 SDA
 *   GPIO10  I2C SCL -> PCA9685 SCL
 *   GPIO8   status LED (plain LED, digitalWrite - no WS2812 / NeoPixel)
 *   PCA9685 ch0..ch3 -> servos 0..3, fed from its own servo power rail
 *
 * No sensors are read on this board. The DHT11 is dead and the MQ-8/MQ-5
 * readings shown on the website are generated by the backend.
 *
 * Command grammar (must match is_valid_command() in the backend):
 *   F B L R S          hold a direction to nudge pan/tilt, S to stop
 *   U D                lift / lower the "Q" pair
 *   A<0..3>:<0..180>   move a single servo channel
 *   P:<0..180>         move both "P" channels (0 and 1)
 *   Q:<0..180>         move both "Q" channels (2 and 3)
 *   RAINBOW_ON / RAINBOW_OFF   blink / turn off the status LED
 *
 * NOTE: the rover's stepper drivers are dead (fried buck converters), so no
 * stepper pins are allocated here. F/B/L/R nudge the pan/tilt pair instead,
 * which keeps the D-pad useful during a demo.
 */

#include <BLE2902.h>
#include <BLEDevice.h>
#include <BLEServer.h>
#include <BLEUtils.h>
#include <Wire.h>
#include <Adafruit_PWMServoDriver.h>

// ------------------------------- config --------------------------------
#define DEVICE_NAME "ESP32C3_Servo"

static const uint8_t NUM_SERVOS = 4;
static const uint8_t SERVO_CHANNELS[NUM_SERVOS] = {0, 1, 2, 3};

static const uint8_t PIN_I2C_SDA = 5;
static const uint8_t PIN_I2C_SCL = 10;
static const uint8_t PCA9685_ADDR = 0x40;

// Typical 500us..2400us servo range at 50 Hz on a 12-bit PCA9685.
static const uint16_t SERVO_MIN_TICKS = 102;
static const uint16_t SERVO_MAX_TICKS = 491;

// Plain LED, not a WS2812 strip. Most ESP32-C3 Super Mini boards wire the
// onboard LED to GPIO8, so set LED_ACTIVE_LOW to false if yours is the other
// way round.
static const uint8_t PIN_LED = 8;
static const bool LED_ACTIVE_LOW = true;

static const uint32_t DRIVE_WATCHDOG_MS = 1000;  // UI refreshes every 250 ms
static const uint32_t PAD_STEP_MS = 40;          // ramp speed while held
static const int PAD_STEP_DEG = 2;
static const uint32_t LED_BLINK_MS = 250;

static const int LIFT_ANGLE = 90;  // "U" - Lift
static const int HOME_ANGLE = 0;   // "D" - Lower

// Nordic UART Service - must match backend/app/robot/controller.py
#define SERVICE_UUID "6E400001-B5A3-F393-E0A9-E50E24DCCA9E"
#define RX_UUID "6E400002-B5A3-F393-E0A9-E50E24DCCA9E"
#define TX_UUID "6E400003-B5A3-F393-E0A9-E50E24DCCA9E"

// ------------------------------ globals --------------------------------
Adafruit_PWMServoDriver pwm = Adafruit_PWMServoDriver(PCA9685_ADDR);

BLECharacteristic *txChar = nullptr;

bool deviceConnected = false;
int angles[NUM_SERVOS] = {90, 90, 90, 90};

volatile char activeDir = 0;
volatile uint32_t lastDirMs = 0;

uint32_t lastStepMs = 0;

bool ledBlinkOn = false;
bool ledLit = false;
uint32_t lastLedMs = 0;

// ------------------------------ servo ----------------------------------
void setChannel(uint8_t channel, int angle) {
  if (channel >= NUM_SERVOS) {
    return;
  }
  angle = constrain(angle, 0, 180);
  if (angle == angles[channel]) {
    return;
  }
  angles[channel] = angle;
  uint16_t ticks = map(angle, 0, 180, SERVO_MIN_TICKS, SERVO_MAX_TICKS);
  pwm.setPWM(SERVO_CHANNELS[channel], 0, ticks);
}

void setPair(uint8_t a, uint8_t b, int angle) {
  setChannel(a, angle);
  setChannel(b, angle);
}

// ------------------------------ commands -------------------------------
void handleCommand(const String &cmd) {
  if (cmd == "RAINBOW_ON") {
    ledBlinkOn = true;
    return;
  }
  if (cmd == "RAINBOW_OFF") {
    ledBlinkOn = false;
    ledLit = false;
    digitalWrite(PIN_LED, LED_ACTIVE_LOW ? HIGH : LOW);
    return;
  }

  if (cmd == "U") {
    setPair(2, 3, LIFT_ANGLE);
    return;
  }
  if (cmd == "D") {
    setPair(2, 3, HOME_ANGLE);
    return;
  }

  if (cmd.length() == 1) {
    char letter = cmd[0];
    if (letter == 'F' || letter == 'B' || letter == 'L' || letter == 'R') {
      activeDir = letter;
      lastDirMs = millis();
      return;
    }
    if (letter == 'S') {
      activeDir = 0;
    }
    return;
  }

  int colon = cmd.indexOf(':');
  if (colon < 0) {
    return;
  }

  String head = cmd.substring(0, colon);
  int value = cmd.substring(colon + 1).toInt();

  if (head == "P") {
    setPair(0, 1, value);
    return;
  }
  if (head == "Q") {
    setPair(2, 3, value);
    return;
  }
  if (head.length() == 2 && head[0] == 'A') {
    setChannel((uint8_t)head.substring(1).toInt(), value);
  }
}

class RxCallbacks : public BLECharacteristicCallbacks {
  void onWrite(BLECharacteristic *characteristic) override {
    // .c_str() keeps this compiling on both ESP32 core 2.x (std::string) and
    // 3.x (String).
    String cmd = String(characteristic->getValue().c_str());
    cmd.trim();
    if (cmd.length() > 0) {
      Serial.print("[rx] ");
      Serial.println(cmd);
      handleCommand(cmd);
    }
  }
};

class ServerCallbacks : public BLEServerCallbacks {
  void onConnect(BLEServer *server) override {
    deviceConnected = true;
    Serial.println("[ble] central connected");
  }

  void onDisconnect(BLEServer *server) override {
    deviceConnected = false;
    activeDir = 0;
    // Without this the peripheral stays invisible forever once the first
    // client disconnects - the bug that made the board vanish from scans.
    server->startAdvertising();
    Serial.println("[ble] central disconnected - advertising again");
  }
};

// -------------------------------- drive --------------------------------
// The steppers are dead, so a "drive" command ramps the pan/tilt pair while
// it is held. Replace this function if the wheels ever come back to life.
void stepDrive() {
  if (activeDir == 0) {
    return;
  }

  // The website refreshes the held direction every 250 ms. If those refreshes
  // stop - link dropped, tab closed - stop moving.
  if (millis() - lastDirMs > DRIVE_WATCHDOG_MS) {
    activeDir = 0;
    return;
  }

  if (millis() - lastStepMs < PAD_STEP_MS) {
    return;
  }
  lastStepMs = millis();

  switch (activeDir) {
    case 'L':
      setChannel(0, angles[0] - PAD_STEP_DEG);
      break;
    case 'R':
      setChannel(0, angles[0] + PAD_STEP_DEG);
      break;
    case 'F':
      setChannel(1, angles[1] + PAD_STEP_DEG);
      break;
    case 'B':
      setChannel(1, angles[1] - PAD_STEP_DEG);
      break;
    default:
      break;
  }
}

// -------------------------------- status LED ---------------------------
void writeLed(bool on) {
  digitalWrite(PIN_LED, LED_ACTIVE_LOW ? (on ? LOW : HIGH) : (on ? HIGH : LOW));
}

void updateLed() {
  if (!ledBlinkOn) {
    // Idle: slow heartbeat so you can tell the board is alive.
    if (millis() - lastLedMs >= 1000) {
      lastLedMs = millis();
      ledLit = !ledLit;
      writeLed(ledLit);
    }
    return;
  }

  if (millis() - lastLedMs >= LED_BLINK_MS) {
    lastLedMs = millis();
    ledLit = !ledLit;
    writeLed(ledLit);
  }
}

// -------------------------------- setup --------------------------------
void setup() {
  Serial.begin(115200);
  delay(300);
  Serial.println("\n[bot] Excavatable ESP32-C3 servo driver starting");

  pinMode(PIN_LED, OUTPUT);
  writeLed(false);

  Wire.begin(PIN_I2C_SDA, PIN_I2C_SCL);
  pwm.begin();
  pwm.setPWMFreq(50);
  delay(10);
  for (uint8_t i = 0; i < NUM_SERVOS; i++) {
    setChannel(i, angles[i]);
  }

  BLEDevice::init(DEVICE_NAME);
  BLEServer *server = BLEDevice::createServer();
  server->setCallbacks(new ServerCallbacks());

  BLEService *service = server->createService(SERVICE_UUID);

  txChar = service->createCharacteristic(TX_UUID, BLECharacteristic::PROPERTY_NOTIFY);
  // Kept even though this board sends no telemetry: the backend subscribes to
  // this characteristic, and the CCCD descriptor is what makes that possible.
  txChar->addDescriptor(new BLE2902());

  BLECharacteristic *rxChar = service->createCharacteristic(
      RX_UUID, BLECharacteristic::PROPERTY_WRITE | BLECharacteristic::PROPERTY_WRITE_NR);
  rxChar->setCallbacks(new RxCallbacks());

  service->start();

  BLEAdvertising *advertising = BLEDevice::getAdvertising();
  advertising->addServiceUUID(SERVICE_UUID);
  advertising->setScanResponse(true);
  BLEDevice::startAdvertising();

  Serial.print("[ble] advertising as ");
  Serial.println(DEVICE_NAME);
}

// --------------------------------- loop --------------------------------
void loop() {
  stepDrive();
  updateLed();
}
